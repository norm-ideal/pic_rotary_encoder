; CAUTION!! OBSOLUTE CODE
; PROBLEM:
;	WHEN ENCODER ROTATES VERY QUICK, THIS PROGRAM TRY TO SEND THE DATA
;	WHILE TX-BUSY. RESULTS IN LOSS OF TRIGGERS.

	list p=16f648a
	include "p16f648a.inc"

	__CONFIG _BODEN_OFF & _CP_OFF & _MCLRE_OFF & _WDT_OFF & _PWRTE_ON & _LVP_OFF & _INTOSC_OSC_NOCLKOUT

	ORG     0000H
	GOTO    MAIN

	ORG     0004H
	RETFIE

STATN   EQU     20H             ; State Now     00 - 11
STATM1  EQU     21H             ; State N-1     00 - 11
STATC   EQU     22H             ; State Combined STN STM1 0000 - 1111
ROTATE  EQU     23H             ; ROTATION {00, 01, 10}
SLEEPC	EQU	24H		; Sleep Counter
LEDT1	EQU	25H		; LED Timer 1
LEDT2	EQU	26H		; LED Timer 2
LASTSW	EQU	27H


MAIN
	MOVLW 0x07              ;Turn comparators off and
	MOVWF CMCON             ;enable pins for I/O
				;functions

	BSF     STATUS,RP0              ; switch bank
	MOVLW   0FH                     ; 0000 1111	A0,A1=Encoder INPUT
					;		A2 = Reset Encoder (NEG)
	MOVWF   TRISA                   ; 		A3 = Shot (NEG)
	MOVLW   03BH
	MOVWF   TRISB                   ; 0000 0010 B2=TxD,B1=RxD
	BCF     STATUS,RP0              ; switchback bank


; UART CONFIGURATION DOCUMENT 40044F P.71
	BSF	STATUS,RP0
	MOVLW	B'00100100'	; CLOCK-N/A, TX9-OFF, TXENABLE=1, ASYNC
				; N/A, BAUDRATE-HIGH, TR.SR-FULL, TX9D=0
	MOVWF	TXSTA
	MOVLW	19H		; F/16/(X+1)
				; 4MHz / 16 / (25+1) = 9615
	MOVWF	SPBRG
	BCF	STATUS,RP0

	CALL	WAIT

	MOVLW	B'10010000'	; SERIAL-ON, 9BIT-OFF, SNGLE-N/A, CONTRCV=ON
				; ADEN-N/A, (FRAMEERR, OVERERR, RX9D)
	MOVWF	RCSTA


	CLRF    PORTA
	CLRF    PORTB
	CLRF    STATN
	CLRF    STATM1
	CLRF    STATC
	CLRF    ROTATE
	MOVLW	B'00001100'
	MOVWF	LASTSW

LOOP
	; Move STATE-NOW to STATE-MINUS1
	; AND TO STATE-COMBINED
	MOVFW   STATN
	MOVWF   STATM1
	MOVWF   STATC

	; CHECK IF SWITCH STATE IS CHANGED
	MOVFW	PORTA
	ANDLW	B'00001100'
	XORWF	LASTSW, F	; 0 IF NOT CHANGED
	MOVWF	LASTSW
	BTFSC	STATUS, Z	; IF NOT ZERO, JMP TO CHECK
	GOTO	SKIPSW		; IF ZERO, SKIP CHECKSWITCH

	; CHECK RESET ENCODER
	MOVLW	'R'
	BTFSS	PORTA, 2		; NEGATIVE LOGIC. 0=PRESSED
	CALL	SENDW

	; CHECK SHOT BUTTON
	MOVLW	'S'
	BTFSS	PORTA, 3		; NEGATIE LOGIC. 0=PRESSED
	CALL	SENDW

SKIPSW
	; STORE LAST 2 BITS FROM PORTA TO STATE-NOW
	MOVFW   PORTA
	ANDLW   B'00000011'
	MOVWF   STATN

	; ROTATE STAT-COMBINED 2 BITS -> GET IT TO WORK
	; 000000XX -> 0000XX00
	CLRC
	RLF     STATC, F
	RLF     STATC, W

	; OR WITH STATE-NOW (NOTE THAT STATE-NOW IS 0000 00YY)
	; 0000XX00 -> 0000XXYY
	IORWF   STATN, W
	; STORE IT TO STATE-COMBINED
	; 0000XXYY
	MOVWF   STATC

	; CALL TURNCHECK WITH W REGISTER -> STORE TO ROTATE
	CALL    TURNCHECK
	MOVWF   ROTATE

	; CHECK CODE
	BTFSC   ROTATE, 0
	GOTO    ROTCW
	BTFSC   ROTATE, 1
	GOTO    ROTCCW

	; NO ROTATION
	DECFSZ	LEDT1
	GOTO	LOOP
	MOVLW	0FFH
	MOVWF	LEDT1
	DECFSZ	LEDT2
	GOTO	LOOP

	; TIMER IS OVER
	BSF	PORTB, 6
	BSF	PORTB, 7
	GOTO    LOOP

ROTCW
	BSF     PORTB, 6
	BCF     PORTB, 7
	MOVLW	'A'
	CALL	SENDW
	GOTO    RESETTIMER

ROTCCW
	BSF     PORTB, 7
	BCF     PORTB, 6
	MOVLW	'B'
	CALL	SENDW
	GOTO    RESETTIMER

RESETTIMER
	MOVLW	0FFH
	MOVWF	LEDT1
	MOVWF	LEDT2
	GOTO	LOOP

SENDW
	;WAIT FOR TX-READY
	BSF	STATUS, RP0
LOOP1
	BTFSS	TXSTA, 1
	GOTO	LOOP1
	BCF	STATUS, RP0
	MOVWF	TXREG
	RETURN

TURNCHECK
	; INPUT:        W 0000XXYY X:FORMER ENC. Y:CURRENT ENC.
	; OUTPUT:       W 00000001 CW   00000010 CCW    0 NO ROT

	; ADD W=STATC TO PROGRAM-COUNTER
	ADDWF   PCL, F
	RETLW   0               ; 0000
	RETLW   1               ; 0001
	RETLW   2               ; 0010
	RETLW   0               ; 0011

	RETLW   2               ; 0100
	RETLW   0               ; 0101
	RETLW   0               ; 0110
	RETLW   1               ; 0111

	RETLW   1               ; 1000
	RETLW   0               ; 1001
	RETLW   0               ; 1010
	RETLW   2               ; 1011

	RETLW   0               ; 1100
	RETLW   2               ; 1101
	RETLW   1               ; 1110
	RETLW   0               ; 1111

WAIT
	MOVLW	0FFH
	MOVWF	SLEEPC
SLOOP	DECFSZ	SLEEPC, F
	GOTO	SLOOP
	RETURN

	END
